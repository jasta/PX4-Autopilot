## src/drivers/adc/grovepiplus/Kconfig
```kconfig
menuconfig DRIVERS_ADC_GROVEPIPLUS
	bool "adc_grovepiplus"
	default n
	---help---
		Enable support for GrovePi+ built-in ADC (ports A0-A2)
```

## src/drivers/barometer/bme280/Kconfig
```kconfig
menuconfig DRIVERS_BAROMETER_BME280
	bool "bme280"
	default n
	---help---
		Enable support for bme280
```

## src/drivers/power_monitor/pijuice/Kconfig
```kconfig
menuconfig DRIVERS_POWER_MONITOR_PIJUICE
	bool "pijuice"
	default n
	---help---
		Enable support for PiJuice power monitoring
```
